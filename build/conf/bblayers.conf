## meta-yocto/conf/distro/include/recipe_color.inc
```bitbake
# This is a "burndown" list of recipes that need to be reviewed
# and corrected based on their color they may have some issues.
# If a recipe is fixed and OK, then its entry can be removed.
#
# The format is as a bitbake variable override for each recipe
#
#       RECIPE_COLOR_pn-<recipe name> = "yellow|red"
#          yellow - recipe needs review and might have issues
#                   including verification of dependencies
#          red - recipe has some known issue that needs correction
#                but does not prevent the build
#
# Please keep this list in alphabetical order.
#

# Default for all recipes not specified here
RECIPE_COLOR = "green"

RECIPE_COLOR_pn-aaina = "red"
RECIPE_COLOR_pn-abiword-embedded = "red"
RECIPE_COLOR_pn-acl = "yellow"
RECIPE_COLOR_pn-apmd = "yellow"
RECIPE_COLOR_pn-apt = "red"
RECIPE_COLOR_pn-aspell = "red"
RECIPE_COLOR_pn-at = "yellow"
RECIPE_COLOR_pn-atk = "yellow"
RECIPE_COLOR_pn-attr = "yellow"
RECIPE_COLOR_pn-autoconf="red"
RECIPE_COLOR_pn-avahi = "yellow"
RECIPE_COLOR_pn-avahi-ui = "yellow"
RECIPE_COLOR_pn-base-files = "yellow"
RECIPE_COLOR_pn-base-passwd = "yellow"
RECIPE_COLOR_pn-bash = "yellow"
RECIPE_COLOR_pn-bc = "yellow"
RECIPE_COLOR_pn-blktool = "yellow"
RECIPE_COLOR_pn-blktrace = "red"
RECIPE_COLOR_pn-bluez-dtl1-workaround="yellow"
RECIPE_COLOR_pn-boost = "yellow"
RECIPE_COLOR_pn-busybox = "yellow"
RECIPE_COLOR_pn-bzip2 = "yellow"
RECIPE_COLOR_pn-calibrateproto = "yellow"
RECIPE_COLOR_pn-cdrtools = "yellow"
RECIPE_COLOR_pn-chrpath = "yellow"
RECIPE_COLOR_pn-claws-mail = "red"
RECIPE_COLOR_pn-claws-plugin-gtkhtml2-viewer = "red"
RECIPE_COLOR_pn-claws-plugin-maildir = "red"
RECIPE_COLOR_pn-claws-plugin-mailmbox = "red"
RECIPE_COLOR_pn-claws-plugin-rssyl = "red"
RECIPE_COLOR_pn-clipboard-manager = "red"
RECIPE_COLOR_pn-clutter-gst-1.8 = "red"
RECIPE_COLOR_pn-clutter-gtk-1.8 = "red"
RECIPE_COLOR_pn-compositeproto = "yellow"
RECIPE_COLOR_pn-console-tools = "red"
RECIPE_COLOR_pn-core-image-clutter = "red"
RECIPE_COLOR_pn-cpio = "yellow"
RECIPE_COLOR_pn-cronie = "yellow"
RECIPE_COLOR_pn-cross-localedef = "red"
RECIPE_COLOR_pn-cups = "red"
RECIPE_COLOR_pn-curl = "yellow"
RECIPE_COLOR_pn-cwautomacros = "yellow"
RECIPE_COLOR_pn-damageproto = "yellow"
RECIPE_COLOR_pn-db = "yellow"
RECIPE_COLOR_pn-dbus-glib = "yellow"
RECIPE_COLOR_pn-dbus-wait = "yellow"
RECIPE_COLOR_pn-desktop-file-utils-native = "red"
RECIPE_COLOR_pn-dmxproto = "yellow"
RECIPE_COLOR_pn-docbook-dsssl-stylesheet = "yellow"
RECIPE_COLOR_pn-docbook-sgml-dtd = "yellow"
RECIPE_COLOR_pn-docbook-utils = "yellow"
RECIPE_COLOR_pn-dosfstools = "yellow"
RECIPE_COLOR_pn-dri2proto = "yellow"
RECIPE_COLOR_pn-dropbear = "yellow"
RECIPE_COLOR_pn-dtc = "red"
RECIPE_COLOR_pn-e2fsprogs = "yellow"
RECIPE_COLOR_pn-ed = "yellow"
RECIPE_COLOR_pn-eggdbus = "yellow"
RECIPE_COLOR_pn-empathy = "red"
RECIPE_COLOR_pn-encodings = "yellow"
RECIPE_COLOR_pn-epdfview = "red"
RECIPE_COLOR_pn-expat = "yellow"
RECIPE_COLOR_pn-farsight2 = "red"
RECIPE_COLOR_pn-findutils = "yellow"
RECIPE_COLOR_pn-fixesproto = "yellow"
RECIPE_COLOR_pn-font-alias = "yellow"
RECIPE_COLOR_pn-fontcacheproto = "yellow"
RECIPE_COLOR_pn-fontconfig = "yellow"
RECIPE_COLOR_pn-fontsproto = "yellow"
RECIPE_COLOR_pn-font-util = "yellow"
RECIPE_COLOR_pn-formfactor = "yellow"
RECIPE_COLOR_pn-freetype = "yellow"
RECIPE_COLOR_pn-fuse = "red"
RECIPE_COLOR_pn-galago-daemon = "yellow"
RECIPE_COLOR_pn-gawk = "red"
RECIPE_COLOR_pn-gcalctool = "red"
RECIPE_COLOR_pn-gccmakedep = "yellow"
RECIPE_COLOR_pn-gconf-dbus = "yellow"
RECIPE_COLOR_pn-gdk-pixbuf-csource-native = "yellow"
RECIPE_COLOR_pn-genext2fs = "yellow"
RECIPE_COLOR_pn-ghostscript = "red"
RECIPE_COLOR_pn-glib-2.0 = "yellow"
RECIPE_COLOR_pn-glibc = "yellow"
RECIPE_COLOR_pn-glproto = "yellow"
RECIPE_COLOR_pn-gnome-common = "yellow"
RECIPE_COLOR_pn-gnome-doc-utils = "yellow"
RECIPE_COLOR_pn-gnome-keyring = "yellow"
RECIPE_COLOR_pn-gnome-mime-data = "yellow"
RECIPE_COLOR_pn-gnome-settings-daemon = "red"
RECIPE_COLOR_pn-gnome-terminal = "red"
RECIPE_COLOR_pn-gnome-vfs = "yellow"
RECIPE_COLOR_pn-gnutls = "yellow"
RECIPE_COLOR_pn-gobject-introspection = "yellow"
RECIPE_COLOR_pn-gperf = "yellow"
RECIPE_COLOR_pn-gpgme = "yellow"
RECIPE_COLOR_pn-grep = "yellow"
RECIPE_COLOR_pn-groff = "red"
RECIPE_COLOR_pn-gtk+ = "yellow"
RECIPE_COLOR_pn-gtk-doc = "red"
RECIPE_COLOR_pn-gtk-sato-engine = "yellow"
RECIPE_COLOR_pn-gtk-theme-torturer = "red"
RECIPE_COLOR_pn-guilt-native = "red"
RECIPE_COLOR_pn-gzip = "yellow"
RECIPE_COLOR_pn-hal = "yellow"
RECIPE_COLOR_pn-hal-info = "yellow"
RECIPE_COLOR_pn-hdparm = "red"
RECIPE_COLOR_pn-hicolor-icon-theme = "yellow"
RECIPE_COLOR_pn-hostap-conf = "red"
RECIPE_COLOR_pn-hostap-utils="yellow"
RECIPE_COLOR_pn-icon-naming-utils = "red"
RECIPE_COLOR_pn-icu = "yellow"
RECIPE_COLOR_pn-initramfs-boot = "yellow"
RECIPE_COLOR_pn-initramfs-live-boot = "yellow"
RECIPE_COLOR_pn-initramfs-live-install = "yellow"
RECIPE_COLOR_pn-initscripts = "yellow"
RECIPE_COLOR_pn-inputproto = "yellow"
RECIPE_COLOR_pn-insserv = "yellow"
RECIPE_COLOR_pn-iproute2 = "yellow"
RECIPE_COLOR_pn-iputils="red"
RECIPE_COLOR_pn-iso-codes = "red"
RECIPE_COLOR_pn-jpeg = "yellow"
RECIPE_COLOR_pn-js = "yellow"
RECIPE_COLOR_pn-kbproto = "yellow"
RECIPE_COLOR_pn-kern-tools-native = "red"
RECIPE_COLOR_pn-keymaps = "yellow"
RECIPE_COLOR_pn-kf = "red"
RECIPE_COLOR_pn-latencytop = "yellow"
RECIPE_COLOR_pn-ldconfig-native = "red"
RECIPE_COLOR_pn-leafpad = "yellow"
RECIPE_COLOR_pn-liba52="yellow"
RECIPE_COLOR_pn-libacpi = "red"
RECIPE_COLOR_pn-libart-lgpl = "yellow"
RECIPE_COLOR_pn-libassuan = "yellow"
RECIPE_COLOR_pn-libatomics-ops = "yellow"
RECIPE_COLOR_pn-libcap = "yellow"
RECIPE_COLOR_pn-libcroco = "yellow"
RECIPE_COLOR_pn-libdaemon = "yellow"
RECIPE_COLOR_pn-libdmx = "yellow"
RECIPE_COLOR_pn-liberation-fonts = "yellow"
RECIPE_COLOR_pn-libetpan = "red"
RECIPE_COLOR_pn-libfakekey = "yellow"
RECIPE_COLOR_pn-libffi  = "red"
RECIPE_COLOR_pn-libfm = "yellow"
RECIPE_COLOR_pn-libfontenc = "yellow"
RECIPE_COLOR_pn-libfribidi = "red"
RECIPE_COLOR_pn-libgalago = "red"
RECIPE_COLOR_pn-libgcrypt = "yellow"
RECIPE_COLOR_pn-libgdbus = "yellow"
RECIPE_COLOR_pn-libglade = "yellow"
RECIPE_COLOR_pn-libgnomecanvas = "red"
RECIPE_COLOR_pn-libgnomekbd = "red"
RECIPE_COLOR_pn-libgnome-keyring = "yellow"
RECIPE_COLOR_pn-libgpg-error = "yellow"
RECIPE_COLOR_pn-libgsf = "red"
RECIPE_COLOR_pn-libgtkstylus = "red"
RECIPE_COLOR_pn-libice = "yellow"
RECIPE_COLOR_pn-libid3tag="yellow"
RECIPE_COLOR_pn-liblbxutil = "yellow"
RECIPE_COLOR_pn-libmatchbox = "yellow"
RECIPE_COLOR_pn-libnice = "red"
RECIPE_COLOR_pn-liboil = "yellow"
RECIPE_COLOR_pn-libomxil = "red"
RECIPE_COLOR_pn-libopensync = "red"
RECIPE_COLOR_pn-libopensync-plugin-evolution2 = "red"
RECIPE_COLOR_pn-libopensync-plugin-file = "red"
RECIPE_COLOR_pn-libopensync-plugin-google-calendar = "red"
RECIPE_COLOR_pn-libopensync-plugin-irmc = "red"
RECIPE_COLOR_pn-libopensync-plugin-syncml = "red"
RECIPE_COLOR_pn-libopensync-plugin-vformat = "red"
RECIPE_COLOR_pn-libowl = "yellow"
RECIPE_COLOR_pn-libowl-av = "yellow"
RECIPE_COLOR_pn-libpam = "yellow"
RECIPE_COLOR_pn-libpciaccess = "yellow"
RECIPE_COLOR_pn-libpng = "yellow"
RECIPE_COLOR_pn-librsvg = "yellow"
RECIPE_COLOR_pn-libsm = "yellow"
RECIPE_COLOR_pn-libsoup = "red"
RECIPE_COLOR_pn-libsoup-2.4 = "yellow"
RECIPE_COLOR_pn-libsync = "red"
RECIPE_COLOR_pn-libsyncml = "red"
RECIPE_COLOR_pn-libtasn1 = "yellow"
RECIPE_COLOR_pn-libtelepathy = "red"
RECIPE_COLOR_pn-libtirpc = "yellow"
RECIPE_COLOR_pn-libunique = "yellow"
RECIPE_COLOR_pn-liburcu = "yellow"
RECIPE_COLOR_pn-libusb1 = "yellow"
RECIPE_COLOR_pn-libuser = "yellow"
RECIPE_COLOR_pn-libx11 = "yellow"
RECIPE_COLOR_pn-libxau = "yellow"
RECIPE_COLOR_pn-libxaw = "red"
RECIPE_COLOR_pn-libxcalibrate = "yellow"
RECIPE_COLOR_pn-libxcb = "yellow"
RECIPE_COLOR_pn-libxcomposite = "yellow"
RECIPE_COLOR_pn-libxcursor = "yellow"
RECIPE_COLOR_pn-libxdamage = "yellow"
RECIPE_COLOR_pn-libxdmcp = "yellow"
RECIPE_COLOR_pn-libxevie = "red"
RECIPE_COLOR_pn-libxext = "yellow"
RECIPE_COLOR_pn-libxfixes = "yellow"
RECIPE_COLOR_pn-libxfont = "yellow"
RECIPE_COLOR_pn-libxft = "yellow"
RECIPE_COLOR_pn-libxi = "yellow"
RECIPE_COLOR_pn-libxinerama = "yellow"
RECIPE_COLOR_pn-libxkbfile = "yellow"
RECIPE_COLOR_pn-libxkbui = "red"
RECIPE_COLOR_pn-libxklavier = "red"
RECIPE_COLOR_pn-libxml2 = "yellow"
RECIPE_COLOR_pn-libxmu = "yellow"
RECIPE_COLOR_pn-libxp = "yellow"
RECIPE_COLOR_pn-libxpm = "yellow"
RECIPE_COLOR_pn-libxprintapputil = "yellow"
RECIPE_COLOR_pn-libxprintutil = "yellow"
RECIPE_COLOR_pn-libxrandr = "yellow"
RECIPE_COLOR_pn-libxrender = "yellow"
RECIPE_COLOR_pn-libxres = "yellow"
RECIPE_COLOR_pn-libxscrnsaver = "yellow"
RECIPE_COLOR_pn-libxsettings-client = "yellow"
RECIPE_COLOR_pn-libxslt = "yellow"
RECIPE_COLOR_pn-libxt = "yellow"
RECIPE_COLOR_pn-libxtrap = "yellow"
RECIPE_COLOR_pn-libxtst = "yellow"
RECIPE_COLOR_pn-libxv = "yellow"
RECIPE_COLOR_pn-libxvmc = "yellow"
RECIPE_COLOR_pn-libxxf86misc = "yellow"
RECIPE_COLOR_pn-libxxf86vm = "yellow"
RECIPE_COLOR_pn-lighttpd = "yellow"
RECIPE_COLOR_pn-linuxdoc-tools = "yellow"
RECIPE_COLOR_pn-loudmouth = "red"
RECIPE_COLOR_pn-lrzsz="yellow"
RECIPE_COLOR_pn-lttng-modules = "yellow"
RECIPE_COLOR_pn-lttng-tools = "yellow"
RECIPE_COLOR_pn-lttng-ust = "yellow"
RECIPE_COLOR_pn-babeltrace = "yellow"
RECIPE_COLOR_pn-makedevs = "yellow"
RECIPE_COLOR_pn-man = "red"
RECIPE_COLOR_pn-man-pages = "red"
RECIPE_COLOR_pn-matchbox-config-gtk = "yellow"
RECIPE_COLOR_pn-matchbox-desktop = "yellow"
RECIPE_COLOR_pn-matchbox-desktop-sato = "yellow"
RECIPE_COLOR_pn-matchbox-keyboard = "yellow"
RECIPE_COLOR_pn-matchbox-panel-2 = "yellow"
RECIPE_COLOR_pn-matchbox-session = "yellow"
RECIPE_COLOR_pn-matchbox-session-sato = "yellow"
RECIPE_COLOR_pn-matchbox-terminal = "yellow"
RECIPE_COLOR_pn-matchbox-theme-sato = "yellow"
RECIPE_COLOR_pn-matchbox-theme-sato-2 = "yellow"
RECIPE_COLOR_pn-matchbox-themes-extra = "red"
RECIPE_COLOR_pn-matchbox-themes-gtk = "red"
RECIPE_COLOR_pn-matchbox-wm = "yellow"
RECIPE_COLOR_pn-mc = "red"
RECIPE_COLOR_pn-mdadm = "yellow"
RECIPE_COLOR_pn-menu-cache = "yellow"
RECIPE_COLOR_pn-mesa-demos = "red"
RECIPE_COLOR_pn-meta-ide-support = "red"
RECIPE_COLOR_pn-meta-toolchain = "red"
RECIPE_COLOR_pn-mingetty = "red"
RECIPE_COLOR_pn-mktemp="red"
RECIPE_COLOR_pn-mobile-broadband-provider-info = "red"
RECIPE_COLOR_pn-moblin-proto = "red"
RECIPE_COLOR_pn-module-init-tools = "yellow"
RECIPE_COLOR_pn-modutils-collateral = "red"
RECIPE_COLOR_pn-modutils-initscripts = "yellow"
RECIPE_COLOR_pn-msynctool = "yellow"
RECIPE_COLOR_pn-mtd-utils = "yellow"
RECIPE_COLOR_pn-mtools = "yellow"
RECIPE_COLOR_pn-neon = "yellow"
RECIPE_COLOR_pn-netbase = "yellow"
RECIPE_COLOR_pn-nfs-utils = "yellow"
RECIPE_COLOR_pn-oh-puzzles = "yellow"
RECIPE_COLOR_pn-openjade = "yellow"
RECIPE_COLOR_pn-openobex = "red"
RECIPE_COLOR_pn-opensp = "yellow"
RECIPE_COLOR_pn-openssh = "yellow"
RECIPE_COLOR_pn-openswan = "red"
RECIPE_COLOR_pn-opkg = "yellow"
RECIPE_COLOR_pn-opkg-collateral = "yellow"
RECIPE_COLOR_pn-opkg-config-base = "yellow"
RECIPE_COLOR_pn-opkg_nogpg = "yellow"
RECIPE_COLOR_pn-opkg-utils = "yellow"
RECIPE_COLOR_pn-oprofile = "yellow"
RECIPE_COLOR_pn-oprofileui = "yellow"
RECIPE_COLOR_pn-owl-video = "yellow"
RECIPE_COLOR_pn-package-index = "red"
RECIPE_COLOR_pn-pax = "yellow"
RECIPE_COLOR_pn-pax-utils = "yellow"
RECIPE_COLOR_pn-pciutils = "yellow"
RECIPE_COLOR_pn-pcmanfm = "yellow"
RECIPE_COLOR_pn-pcmciautils = "yellow"
RECIPE_COLOR_pn-pixman = "yellow"
RECIPE_COLOR_pn-pkgconfig = "yellow"
RECIPE_COLOR_pn-pm-utils = "yellow"
RECIPE_COLOR_pn-pointercal = "yellow"
RECIPE_COLOR_pn-poky-feed-config-opkg = "yellow"
RECIPE_COLOR_pn-polkit = "yellow"
RECIPE_COLOR_pn-polkit-gnome = "yellow"
RECIPE_COLOR_pn-pong-clock = "red"
RECIPE_COLOR_pn-poppler = "red"
RECIPE_COLOR_pn-poppler-data = "red"
RECIPE_COLOR_pn-portmap = "yellow"
RECIPE_COLOR_pn-powertop = "yellow"
RECIPE_COLOR_pn-ppp-dialin = "red"
RECIPE_COLOR_pn-printproto = "yellow"
RECIPE_COLOR_pn-prism-firmware = "red"
RECIPE_COLOR_pn-procps = "red"
RECIPE_COLOR_pn-psmisc = "red"
RECIPE_COLOR_pn-psplash = "yellow"
RECIPE_COLOR_pn-pth = "yellow"
RECIPE_COLOR_pn-puzzles = "red"
RECIPE_COLOR_pn-python-gst="red"
RECIPE_COLOR_pn-python-pycurl = "yellow"
RECIPE_COLOR_pn-python-pygtk="red"
RECIPE_COLOR_pn-python="red"
RECIPE_COLOR_pn-qemu = "yellow"
RECIPE_COLOR_pn-qemu-config = "red"
RECIPE_COLOR_pn-qemu-helper-native = "yellow"
RECIPE_COLOR_pn-qemu-helper-nativesdk = "yellow"
RECIPE_COLOR_pn-quota = "yellow"
RECIPE_COLOR_pn-randrproto = "yellow"
RECIPE_COLOR_pn-readline = "yellow"
RECIPE_COLOR_pn-recordproto = "yellow"
RECIPE_COLOR_pn-renderproto = "yellow"
RECIPE_COLOR_pn-resourceproto = "yellow"
RECIPE_COLOR_pn-rpcbind = "yellow"
RECIPE_COLOR_pn-rpm = "yellow"
RECIPE_COLOR_pn-run-postinsts = "red"
RECIPE_COLOR_pn-rxvt-unicode = "yellow"
RECIPE_COLOR_pn-sato-icon-theme = "yellow"
RECIPE_COLOR_pn-screen = "yellow"
RECIPE_COLOR_pn-screenshot = "yellow"
RECIPE_COLOR_pn-scrnsaverproto = "yellow"
RECIPE_COLOR_pn-sed = "yellow"
RECIPE_COLOR_pn-setserial = "red"
RECIPE_COLOR_pn-settings-daemon = "yellow"
RECIPE_COLOR_pn-sgml-common = "yellow"
RECIPE_COLOR_pn-sgmlspl = "yellow"
RECIPE_COLOR_pn-shadow = "yellow"
RECIPE_COLOR_pn-shasum-native = "red"
RECIPE_COLOR_pn-signgp-native = "red"
RECIPE_COLOR_pn-spectrum-fw = "red"
RECIPE_COLOR_pn-sqlite3 = "yellow"
RECIPE_COLOR_pn-startup-notification = "yellow"
RECIPE_COLOR_pn-stat = "red"
RECIPE_COLOR_pn-strace = "yellow"
RECIPE_COLOR_pn-sudo = "yellow"
RECIPE_COLOR_pn-swabber = "red"
RECIPE_COLOR_pn-sysfsutils = "yellow"
RECIPE_COLOR_pn-sysklogd = "red"
RECIPE_COLOR_pn-syslinux = "yellow"
RECIPE_COLOR_pn-sysprof = "red"
RECIPE_COLOR_pn-sysvinit = "yellow"
RECIPE_COLOR_pn-table = "red"
RECIPE_COLOR_pn-tar = "yellow"
RECIPE_COLOR_pn-packagegroup-base = "red"
RECIPE_COLOR_pn-packagegroup-core-sdk = "red"
RECIPE_COLOR_pn-packagegroup-core-standalone-sdk-target = "red"
RECIPE_COLOR_pn-packagegroup-sdk-host = "red"
RECIPE_COLOR_pn-tcf-agent = "yellow"
RECIPE_COLOR_pn-tcp-wrappers = "yellow"
RECIPE_COLOR_pn-telepathy-farsight = "red"
RECIPE_COLOR_pn-telepathy-gabble = "red"
RECIPE_COLOR_pn-tidy = "red"
RECIPE_COLOR_pn-time = "yellow"
RECIPE_COLOR_pn-tinylogin = "yellow"
RECIPE_COLOR_pn-trapproto = "yellow"
RECIPE_COLOR_pn-tslib = "yellow"
RECIPE_COLOR_pn-ttf-bitstream-vera = "yellow"
RECIPE_COLOR_pn-tzdata = "yellow"
RECIPE_COLOR_pn-ubootchart = "red"
RECIPE_COLOR_pn-u-boot-mkimage = "red"
RECIPE_COLOR_pn-udev = "yellow"
RECIPE_COLOR_pn-udev-extraconf = "yellow"
RECIPE_COLOR_pn-unfs-server = "red"
RECIPE_COLOR_pn-unzip = "yellow"
RECIPE_COLOR_pn-update-rc.d = "yellow"
RECIPE_COLOR_pn-usbinit = "red"
RECIPE_COLOR_pn-util-macros = "yellow"
RECIPE_COLOR_pn-v86d = "yellow"
RECIPE_COLOR_pn-valgrind = "yellow"
RECIPE_COLOR_pn-videoproto = "yellow"
RECIPE_COLOR_pn-watchdog = "yellow"
RECIPE_COLOR_pn-wbxml2 = "red"
RECIPE_COLOR_pn-webkit-gtk = "yellow"
RECIPE_COLOR_pn-web-webkit = "yellow"
RECIPE_COLOR_pn-which = "yellow"
RECIPE_COLOR_pn-wireless-tools="yellow"
RECIPE_COLOR_pn-wv = "red"
RECIPE_COLOR_pn-xbacklight = "red"
RECIPE_COLOR_pn-xcb-proto = "yellow"
RECIPE_COLOR_pn-xcb-util = "yellow"
RECIPE_COLOR_pn-xcmiscproto = "yellow"
RECIPE_COLOR_pn-xcursor-transparent-theme = "yellow"
RECIPE_COLOR_pn-xev = "red"
RECIPE_COLOR_pn-xextproto = "yellow"
RECIPE_COLOR_pn-xeyes = "red"
RECIPE_COLOR_pn-xf86bigfontproto = "yellow"
RECIPE_COLOR_pn-xf86dgaproto = "yellow"
RECIPE_COLOR_pn-xf86driproto = "yellow"
RECIPE_COLOR_pn-xf86-input-synaptics = "red"
RECIPE_COLOR_pn-xf86miscproto = "yellow"
RECIPE_COLOR_pn-xf86rushproto = "yellow"
RECIPE_COLOR_pn-xf86-video-intel = "red"
RECIPE_COLOR_pn-xf86-video-omapfb = "red"
RECIPE_COLOR_pn-xf86vidmodeproto = "yellow"
RECIPE_COLOR_pn-xineramaproto = "yellow"
RECIPE_COLOR_pn-xinetd="red"
RECIPE_COLOR_pn-xkeyboard-config = "yellow"
RECIPE_COLOR_pn-xorg-minimal-fonts = "yellow"
RECIPE_COLOR_pn-xournal = "red"
RECIPE_COLOR_pn-xproto = "yellow"
RECIPE_COLOR_pn-xproxymanagementprotocol = "yellow"
RECIPE_COLOR_pn-xrdb = "red"
RECIPE_COLOR_pn-xrestop = "yellow"
RECIPE_COLOR_pn-xtrans = "yellow"
RECIPE_COLOR_pn-xtscal = "yellow"
RECIPE_COLOR_pn-xz = "yellow"
RECIPE_COLOR_pn-yaffs2-utils = "red"
RECIPE_COLOR_pn-zeroconf = "red"
RECIPE_COLOR_pn-zip = "yellow"
RECIPE_COLOR_pn-zlib = "yellow"
```
