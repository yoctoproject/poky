## scripts/lib/bsp/substrate/target/arch/arm/conf/machine/{{=machine}}.conf
```bitbake
#@TYPE: Machine
#@NAME: {{=machine}}

#@DESCRIPTION: Machine configuration for {{=machine}} systems

{{ input type:"boolean" name:"xserver" prio:"50" msg:"Do you need support for X? (y/n)" default:"y" }}
{{ if xserver == "y": }}
PREFERRED_PROVIDER_virtual/xserver ?= "xserver-xorg"
XSERVER ?= "xserver-xorg \
           xf86-input-evdev \
           xf86-input-mouse \
           xf86-video-omapfb \
           xf86-input-keyboard"

# Ship all kernel modules by default
MACHINE_EXTRA_RRECOMMENDS = " kernel-modules"

# Allow for MMC booting (required by the NAND-less Beagleboard XM)
EXTRA_IMAGEDEPENDS += "u-boot"

# Uncomment the following line to enable the hard floating point abi. Note that
# this breaks some binary libraries and 3D (neither of which ship with
# meta-yocto). For maximum compatibility, leave this disabled.
#DEFAULTTUNE ?= "cortexa8hf-neon"
{{ input type:"choicelist" name:"tunefile" prio:"40" msg:"Which machine tuning would you like to use?" default:"tune_cortexa8" }}
{{ input type:"choice" val:"tune_arm1136jf_s" msg:"arm1136jf-s tuning optimizations" }}
{{ input type:"choice" val:"tune_arm920t" msg:"arm920t tuning optimizations" }}
{{ input type:"choice" val:"tune_arm926ejs" msg:"arm926ejs tuning optimizations" }}
{{ input type:"choice" val:"tune_arm9tdmi" msg:"arm9tdmi tuning optimizations" }}
{{ input type:"choice" val:"tune_cortexa5" msg:"cortexa5 tuning optimizations" }}
{{ input type:"choice" val:"tune_cortexa7" msg:"cortexa7 tuning optimizations" }}
{{ input type:"choice" val:"tune_cortexa8" msg:"cortexa8 tuning optimizations" }}
{{ input type:"choice" val:"tune_cortexa9" msg:"cortexa9 tuning optimizations" }}
{{ input type:"choice" val:"tune_cortexa15" msg:"cortexa15 tuning optimizations" }}
{{ input type:"choice" val:"tune_cortexm1" msg:"cortexm1 tuning optimizations" }}
{{ input type:"choice" val:"tune_cortexm3" msg:"cortexm3 tuning optimizations" }}
{{ input type:"choice" val:"tune_cortexr4" msg:"cortexr4 tuning optimizations" }}
{{ input type:"choice" val:"tune_ep9312" msg:"ep9312 tuning optimizations" }}
{{ input type:"choice" val:"tune_iwmmxt" msg:"iwmmxt tuning optimizations" }}
{{ input type:"choice" val:"tune_strongarm1100" msg:"strongarm1100 tuning optimizations" }}
{{ input type:"choice" val:"tune_xscale" msg:"xscale tuning optimizations" }}
{{ if tunefile == "tune_arm1136jf_s": }}
include conf/machine/include/tune-arm1136jf-s.inc
{{ if tunefile == "tune_arm920t": }}
include conf/machine/include/tune-arm920t.inc
{{ if tunefile == "tune_arm926ejs": }}
include conf/machine/include/tune-arm926ejs.inc
{{ if tunefile == "tune_arm9tdmi": }}
include conf/machine/include/tune-arm9tdmi.inc
{{ if tunefile == "tune_cortexa5": }}
include conf/machine/include/tune-cortexa5.inc
{{ if tunefile == "tune_cortexa7": }}
include conf/machine/include/tune-cortexa7.inc
{{ if tunefile == "tune_cortexa8": }}
include conf/machine/include/tune-cortexa8.inc
{{ if tunefile == "tune_cortexa9": }}
include conf/machine/include/tune-cortexa9.inc
{{ if tunefile == "tune_cortexa15": }}
include conf/machine/include/tune-cortexa15.inc
{{ if tunefile == "tune_cortexm1": }}
include conf/machine/include/tune-cortexm1.inc
{{ if tunefile == "tune_cortexm3": }}
include conf/machine/include/tune-cortexm3.inc
{{ if tunefile == "tune_cortexr4": }}
include conf/machine/include/tune-cortexr4.inc
{{ if tunefile == "tune_ep9312": }}
include conf/machine/include/tune-ep9312.inc
{{ if tunefile == "tune_iwmmxt": }}
include conf/machine/include/tune-iwmmxt.inc
{{ if tunefile == "tune_strongarm1100": }}
include conf/machine/include/tune-strongarm1100.inc
{{ if tunefile == "tune_xscale": }}
include conf/machine/include/tune-xscale.inc

IMAGE_FSTYPES += "tar.bz2 jffs2"
EXTRA_IMAGECMD_jffs2 = "-lnp "

# 2.6.37 and later kernels use OMAP_SERIAL, ttyO2
# earlier kernels use ttyS2
SERIAL_CONSOLE = "115200 ttyO2"

{{ if kernel_choice == "custom": preferred_kernel = "linux-yocto-custom" }}
{{ if kernel_choice == "linux-yocto-dev": preferred_kernel = "linux-yocto-dev" }}
{{ if kernel_choice == "custom" or kernel_choice == "linux-yocto-dev" : }}
PREFERRED_PROVIDER_virtual/kernel ?= "{{=preferred_kernel}}"

{{ if kernel_choice != "custom" and kernel_choice != "linux-yocto-dev": preferred_kernel = kernel_choice.split('_')[0] }}
{{ if kernel_choice != "custom" and kernel_choice != "linux-yocto-dev": preferred_kernel_version = kernel_choice.split('_')[1] }}
{{ if kernel_choice != "custom" and kernel_choice != "linux-yocto-dev": }}
PREFERRED_PROVIDER_virtual/kernel ?= "{{=preferred_kernel}}"
PREFERRED_VERSION_{{=preferred_kernel}} ?= "{{=preferred_kernel_version}}%"

KERNEL_IMAGETYPE = "zImage"
KERNEL_DEVICETREE = "${S}/arch/arm/boot/dts/omap3-beagle.dts ${S}/arch/arm/boot/dts/omap3-beagle-xm.dts"

SPL_BINARY = "MLO"
UBOOT_SUFFIX = "img"
{{ input type:"edit" name:"uboot_machine" prio:"40" msg:"Please specify a value for UBOOT_MACHINE:" default:"omap3_beagle_config" }}
UBOOT_MACHINE = "{{=uboot_machine}}"
{{ input type:"edit" name:"uboot_entrypoint" prio:"40" msg:"Please specify a value for UBOOT_ENTRYPOINT:" default:"0x80008000" }}
UBOOT_ENTRYPOINT = "{{=uboot_entrypoint}}"
{{ input type:"edit" name:"uboot_loadaddress" prio:"40" msg:"Please specify a value for UBOOT_LOADADDRESS:" default:"0x80008000" }}
UBOOT_LOADADDRESS = "{{=uboot_loadaddress}}"

MACHINE_FEATURES = "usbgadget usbhost vfat alsa"
```

## scripts/lib/bsp/substrate/target/arch/common/conf/layer.conf
```bitbake
# We have a conf and classes directory, add to BBPATH
BBPATH := "${BBPATH}:${LAYERDIR}"

# We have a recipes directory, add to BBFILES
BBFILES := "${BBFILES} ${LAYERDIR}/recipes-*/*/*.bb \
	${LAYERDIR}/recipes-*/*/*.bbappend"

BBFILE_COLLECTIONS += "{{=machine}}"
BBFILE_PATTERN_{{=machine}} := "^${LAYERDIR}/"
BBFILE_PRIORITY_{{=machine}} = "6"
```

## scripts/lib/bsp/substrate/target/arch/i386/conf/machine/{{=machine}}.conf
```bitbake
#@TYPE: Machine
#@NAME: {{=machine}}

#@DESCRIPTION: Machine configuration for {{=machine}} systems

{{ if kernel_choice == "custom": preferred_kernel = "linux-yocto-custom" }}
{{ if kernel_choice == "linux-yocto-dev": preferred_kernel = "linux-yocto-dev" }}
{{ if kernel_choice == "custom" or kernel_choice == "linux-yocto-dev" : }}
PREFERRED_PROVIDER_virtual/kernel ?= "{{=preferred_kernel}}"

{{ if kernel_choice != "custom" and kernel_choice != "linux-yocto-dev": preferred_kernel = kernel_choice.split('_')[0] }}
{{ if kernel_choice != "custom" and kernel_choice != "linux-yocto-dev": preferred_kernel_version = kernel_choice.split('_')[1] }}
{{ if kernel_choice != "custom" and kernel_choice != "linux-yocto-dev": }}
PREFERRED_PROVIDER_virtual/kernel ?= "{{=preferred_kernel}}"
PREFERRED_VERSION_{{=preferred_kernel}} ?= "{{=preferred_kernel_version}}%"

{{ input type:"choicelist" name:"tunefile" prio:"40" msg:"Which machine tuning would you like to use?" default:"tune_core2" }}
{{ input type:"choice" val:"tune_i586" msg:"i586 tuning optimizations" }}
{{ input type:"choice" val:"tune_atom" msg:"Atom tuning optimizations" }}
{{ input type:"choice" val:"tune_core2" msg:"Core2 tuning optimizations" }}
{{ if tunefile == "tune_i586": }}
require conf/machine/include/tune-i586.inc
{{ if tunefile == "tune_atom": }}
require conf/machine/include/tune-atom.inc
{{ if tunefile == "tune_core2": }}
require conf/machine/include/tune-core2.inc

require conf/machine/include/ia32-base.inc
{{ if xserver == "y" and xserver_choice == "xserver_emgd": }}
require conf/machine/include/meta-intel.inc

{{ input type:"boolean" name:"xserver" prio:"50" msg:"Do you need support for X? (y/n)" default:"y" }}

{{ if xserver == "y" and (kernel_choice == "linux-yocto_3.4" or kernel_choice == "linux-yocto_3.8"): }}
{{ input type:"choicelist" name:"xserver_choice" prio:"50" msg:"Please select an xserver for this machine:" default:"xserver_i915" }}
{{ input type:"choice" val:"xserver_vesa" msg:"VESA xserver support" }}
{{ input type:"choice" val:"xserver_emgd" msg:"EMGD xserver support (proprietary)" }}
{{ input type:"choice" val:"xserver_i915" msg:"i915 xserver support" }}

{{ if xserver == "y" and kernel_choice == "custom": }}
{{ input type:"choicelist" name:"xserver_choice" prio:"50" msg:"Please select an xserver for this machine:" default:"xserver_i915" }}
{{ input type:"choice" val:"xserver_vesa" msg:"VESA xserver support" }}
{{ input type:"choice" val:"xserver_i915" msg:"i915 xserver support" }}

{{ if xserver == "y" and kernel_choice != "linux-yocto_3.4" and kernel_choice != "linux-yocto_3.8" and kernel_choice != "custom": xserver_choice = "xserver_i915" }}

{{ if xserver == "y": }}
XSERVER ?= "${XSERVER_IA32_BASE} \
           ${XSERVER_IA32_EXT} \
{{ if xserver == "y" and xserver_choice == "xserver_vesa": }}
           ${XSERVER_IA32_VESA} \
{{ if xserver == "y" and xserver_choice == "xserver_emgd": }}
           ${XSERVER_IA32_EMGD} \
{{ if xserver == "y" and xserver_choice == "xserver_i915": }}
           ${XSERVER_IA32_I915} \
{{ if xserver == "y": }}
           "

{{ if xserver == "y" and xserver_choice == "xserver_emgd": }}
PREFERRED_VERSION_xserver-xorg ?= "1.9.3"
PREFERRED_VERSION_mesa ?= "9.0.2"
PREFERRED_VERSION_xf86-input-evdev ?= "2.6.0"
PREFERRED_VERSION_emgd-driver-bin ?= "1.16"

{{ if xserver == "y" and xserver_choice == "xserver_vesa" or xserver_choice == "xserver_emgd": }}
APPEND += "video=vesafb vga=0x318 vmalloc=256MB"
```

## scripts/lib/bsp/substrate/target/arch/mips/conf/machine/{{=machine}}.conf
```bitbake
#@TYPE: Machine
#@NAME: {{=machine}}

#@DESCRIPTION: Machine configuration for {{=machine}} systems

require conf/machine/include/tune-mips32.inc

MACHINE_FEATURES = "screen keyboard pci usbhost ext2 ext3 serial"

KERNEL_IMAGETYPE = "vmlinux"
KERNEL_ALT_IMAGETYPE = "vmlinux.bin"

{{ preferred_kernel = kernel_choice.split('_')[0] }}
{{ preferred_kernel_version = kernel_choice.split('_')[1] }}
PREFERRED_PROVIDER_virtual/kernel ?= "{{=preferred_kernel}}"
PREFERRED_VERSION_{{=preferred_kernel}} ?= "{{=preferred_kernel_version}}%"

{{ input type:"boolean" name:"xserver" prio:"50" msg:"Do you need support for X? (y/n)" default:"y" }}
{{ if xserver == "y": }}
PREFERRED_PROVIDER_virtual/xserver = "xserver-kdrive"
XSERVER = "xserver-kdrive-fbdev"

SERIAL_CONSOLE = "115200 ttyS0"

MACHINE_EXTRA_RRECOMMENDS = " kernel-modules"

IMAGE_FSTYPES ?= "jffs2 tar.bz2"
```

## scripts/lib/bsp/substrate/target/arch/powerpc/conf/machine/{{=machine}}.conf
```bitbake
#@TYPE: Machine
#@NAME: {{=machine}}

#@DESCRIPTION: Machine configuration for {{=machine}} systems

TARGET_FPU = ""

{{ input type:"choicelist" name:"tunefile" prio:"40" msg:"Which machine tuning would you like to use?" default:"tune_ppc603e" }}
{{ input type:"choice" val:"tune_ppc603e" msg:"ppc603e tuning optimizations" }}
{{ input type:"choice" val:"tune_ppce300c2" msg:"ppce300c2 tuning optimizations" }}
{{ input type:"choice" val:"tune_ppce500" msg:"ppce500 tuning optimizations" }}
{{ input type:"choice" val:"tune_ppce500mc" msg:"ppce500mc tuning optimizations" }}
{{ input type:"choice" val:"tune_ppce500v2" msg:"ppce500v2 tuning optimizations" }}
{{ input type:"choice" val:"tune_ppce5500_32b" msg:"ppce5500-32b tuning optimizations" }}
{{ input type:"choice" val:"tune_ppce5500_64b" msg:"ppce5500-64b tuning optimizations" }}
{{ if tunefile == "tune_ppc603e": }}
include conf/machine/include/tune-ppc603e.inc
{{ if tunefile == "tune_ppce300c2": }}
include conf/machine/include/tune-ppce300c2.inc
{{ if tunefile == "tune_ppce500": }}
include conf/machine/include/tune-ppce500.inc
{{ if tunefile == "tune_ppce500mc": }}
include conf/machine/include/tune-ppce500mc.inc
{{ if tunefile == "tune_ppce500v2": }}
include conf/machine/include/tune-ppce500v2.inc
{{ if tunefile == "tune_ppce5500_32b": }}
include conf/machine/include/tune-ppce5500-32b.inc
{{ if tunefile == "tune_ppce5500_64b": }}
include conf/machine/include/tune-ppce5500-64b.inc

KERNEL_IMAGETYPE = "uImage"

SERIAL_CONSOLE = "115200 ttyS0"

MACHINE_FEATURES = "keyboard pci ext2 ext3 serial"

{{ preferred_kernel = kernel_choice.split('_')[0] }}
{{ preferred_kernel_version = kernel_choice.split('_')[1] }}
PREFERRED_PROVIDER_virtual/kernel ?= "{{=preferred_kernel}}"
PREFERRED_VERSION_{{=preferred_kernel}} ?= "{{=preferred_kernel_version}}%"

{{ input type:"boolean" name:"xserver" prio:"50" msg:"Do you need support for X? (y/n)" default:"y" }}
{{ if xserver == "y": }}
PREFERRED_PROVIDER_virtual/xserver = "xserver-kdrive"
XSERVER = "xserver-kdrive-fbdev"

{{ input type:"edit" name:"uboot_entrypoint" prio:"40" msg:"Please specify a value for UBOOT_ENTRYPOINT:" default:"0x00000000" }}
UBOOT_ENTRYPOINT = "{{=uboot_entrypoint}}"

{{ input type:"edit" name:"kernel_devicetree" prio:"40" msg:"Please specify a [arch/powerpc/boot/dts/xxx] value for KERNEL_DEVICETREE:" default:"mpc8315erdb.dts" }}
KERNEL_DEVICETREE = "${S}/arch/powerpc/boot/dts/{{=kernel_devicetree}}"

MACHINE_EXTRA_RRECOMMENDS = " kernel-modules"
```

## scripts/lib/bsp/substrate/target/arch/qemu/conf/machine/{{=machine}}.conf
```bitbake
#@TYPE: Machine
#@NAME: {{=machine}}

#@DESCRIPTION: Machine configuration for {{=machine}} systems

{{ preferred_kernel = kernel_choice.split('_')[0] }}
{{ preferred_kernel_version = kernel_choice.split('_')[1] }}
PREFERRED_PROVIDER_virtual/kernel ?= "{{=preferred_kernel}}"
PREFERRED_VERSION_{{=preferred_kernel}} ?= "{{=preferred_kernel_version}}%"

PREFERRED_PROVIDER_virtual/xserver ?= "xserver-xorg"
PREFERRED_PROVIDER_virtual/libgl ?= "mesa-dri"

{{ input type:"choicelist" name:"qemuarch" prio:"5" msg:"Which qemu architecture would you like to use?" default:"i386" }}
{{ input type:"choice" val:"i386" msg:"i386    (32-bit)" }}
{{ input type:"choice" val:"x86_64" msg:"x86_64  (64-bit)" }}
{{ input type:"choice" val:"arm" msg:"ARM     (32-bit)" }}
{{ input type:"choice" val:"powerpc" msg:"PowerPC (32-bit)" }}
{{ input type:"choice" val:"mips" msg:"MIPS    (32-bit)" }}
{{ if qemuarch == "i386": }}
require conf/machine/include/tune-i586.inc
{{ if qemuarch == "x86_64": }}
require conf/machine/include/tune-x86_64.inc
{{ if qemuarch == "arm": }}
require conf/machine/include/tune-arm926ejs.inc
{{ if qemuarch == "powerpc": }}
require conf/machine/include/tune-ppc603e.inc
{{ if qemuarch == "mips": }}
require conf/machine/include/tune-mips32.inc

require conf/machine/include/qemu.inc

{{ if qemuarch == "i386" or qemuarch == "x86_64": }}
MACHINE_FEATURES += "x86"
KERNEL_IMAGETYPE = "bzImage"
SERIAL_CONSOLE = "115200 ttyS0"
# We bypass swrast but we need it to be present for X to load correctly
XSERVER ?= "xserver-xorg \
           mesa-dri-driver-swrast \
           xf86-input-vmmouse \
           xf86-input-keyboard \
           xf86-input-evdev \
           xf86-video-vmware \
           qemugl"
GLIBC_ADDONS = "nptl"
GLIBC_EXTRA_OECONF = "--with-tls"

{{ if qemuarch == "arm": }}
KERNEL_IMAGETYPE = "zImage"
SERIAL_CONSOLE = "115200 ttyAMA0"

{{ if qemuarch == "powerpc": }}
KERNEL_IMAGETYPE = "vmlinux"
SERIAL_CONSOLE = "115200 ttyS0"

{{ if qemuarch == "mips": }}
KERNEL_IMAGETYPE = "vmlinux"
KERNEL_ALT_IMAGETYPE = "vmlinux.bin"
SERIAL_CONSOLE = "115200 ttyS0"
MACHINE_EXTRA_RRECOMMENDS = " kernel-modules"
```
